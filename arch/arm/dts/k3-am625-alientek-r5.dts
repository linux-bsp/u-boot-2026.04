// SPDX-License-Identifier: GPL-2.0
/*
 * ALIENTEK ATK-DLAM62xB device tree for R5 SPL
 */

#include "k3-am625-alientek.dts"
#include "k3-am62x-sk-ddr4-1600MTs.dtsi"
#include "k3-am62-ddr.dtsi"

#include "k3-am625-alientek-u-boot.dtsi"
#include "k3-am625-r5.dtsi"

&main_pktdma {
	ti,sci = <&dm_tifs>;
	bootph-all;
};
