// SPDX-License-Identifier: GPL-2.0
/*
 * U-Boot additions for ALIENTEK ATK-DLAM62xB
 */

#include "k3-am625-sk-u-boot.dtsi"

#ifdef CONFIG_TARGET_AM625_A53_EVM

/* Override the SK filename inherited from k3-am625-sk-binman.dtsi. */
&spl_am625_sk_dtb {
	filename = "spl/dts/ti/k3-am625-alientek.dtb";
};

&spl_am625_sk_dtb_unsigned {
	filename = "spl/dts/ti/k3-am625-alientek.dtb";
};

#endif
